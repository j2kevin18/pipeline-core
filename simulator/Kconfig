## simulator/Kconfig
```kconfig
mainmenu "NEMU Configuration Menu"  #定义主菜单标题

choice  
  prompt "Base ISA"  
  default ISA_riscv  
config ISA_riscv
  bool "riscv"
endchoice


source "src/memory/Kconfig"
source "src/trace/Kconfig"
source "src/device/Kconfig"

config NPC_OPEN_SIM
  bool 
  prompt "(npc) Open Simulation"
  default y

config DIFFTEST
  bool 
  prompt "Open Difftest"
  default y
```

## simulator/src/device/Kconfig
```kconfig
menu "DEVICE"


config SERIAL_MMIO
  hex "MMIO address of the serial controller"
  default 0xa00003f8  
config RTC_MMIO
  hex "MMIO address of the timer"
  default 0xa0000048

endmenu
```
